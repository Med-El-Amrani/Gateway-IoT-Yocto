## meta-drivers/conf/layer.conf
```bitbake
# SPDX-License-Identifier: MIT
BBPATH .= ":${LAYERDIR}"
BBFILES += "${LAYERDIR}/recipes-*/*/*.bb ${LAYERDIR}/recipes-*/*/*.bbappend"

BBFILE_COLLECTIONS += "drivers"
BBFILE_PATTERN_drivers = "^${LAYERDIR}/"
BBFILE_PRIORITY_drivers = "6"

LAYERDEPENDS_drivers = "core"
LAYERSERIES_COMPAT_drivers = "scarthgap"
```
