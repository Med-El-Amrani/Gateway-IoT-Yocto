// SPDX-License-Identifier: GPL-2.0-only
/dts-v1/;
/plugin/;

/ {
	compatible = "brcm,bcm2711";

	fragment@0 {
		target-path = "/";
		__overlay__ {
			led_button {
				compatible = "custom,led-button";
				led-gpios = <&gpio 17 0>;
				status = "okay";
			};
		};
	};
};
