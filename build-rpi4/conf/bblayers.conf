## build-rpi4/conf/bblayers.conf
```bitbake
# POKY_BBLAYERS_CONF_VERSION is increased each time build/conf/bblayers.conf
# changes incompatibly
POKY_BBLAYERS_CONF_VERSION = "2"

BBPATH = "${TOPDIR}"
BBFILES ?= ""

BBLAYERS ?= " \
  /home/amrani/projects/IoT_GATEWAY/yocto/poky/meta \
  /home/amrani/projects/IoT_GATEWAY/yocto/poky/meta-poky \
  /home/amrani/projects/IoT_GATEWAY/yocto/poky/meta-yocto-bsp \
  /home/amrani/projects/IoT_GATEWAY/yocto/meta-openembedded/meta-oe \
  /home/amrani/projects/IoT_GATEWAY/yocto/meta-openembedded/meta-filesystems \
  /home/amrani/projects/IoT_GATEWAY/yocto/meta-openembedded/meta-networking \
  /home/amrani/projects/IoT_GATEWAY/yocto/meta-openembedded/meta-webserver \
  /home/amrani/projects/IoT_GATEWAY/yocto/meta-openembedded/meta-python \
  /home/amrani/projects/IoT_GATEWAY/yocto/meta-raspberrypi \
  /home/amrani/projects/IoT_GATEWAY/yocto/meta-iotgw \
  "
```

## meta-iotgw/conf/layer.conf
```bitbake
# We have a conf and classes directory, add to BBPATH
BBPATH .= ":${LAYERDIR}"

# We have recipes-* directories, add to BBFILES
BBFILES += "${LAYERDIR}/recipes-*/*/*.bb \
            ${LAYERDIR}/recipes-*/*/*.bbappend"

BBFILE_COLLECTIONS += "meta-iotgw"
BBFILE_PATTERN_meta-iotgw = "^${LAYERDIR}/"
BBFILE_PRIORITY_meta-iotgw = "6"

LAYERDEPENDS_meta-iotgw = "core"
LAYERSERIES_COMPAT_meta-iotgw = "scarthgap"
```
